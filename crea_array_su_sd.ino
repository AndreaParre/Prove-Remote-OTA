                                                                                                                                                       void createArray_sd(const char *filename) {

  // Open the named file
 // File jpgFile = SPIFFS.open( filename, "r");    // File handle reference for SPIFFS
  fs::  File jpgFile = SD.open( filename, FILE_READ);  // or, file handle reference for SD library

  if ( !jpgFile ) {
    Serial.print("ERROR: File \""); Serial.print(filename); Serial.println ("\" not found!");
    return;
     
  }



  uint8_t data;
  byte line_len = 0;
  Serial.println("");
  Serial.println("// Generated by a JPEGDecoder library example sketch:");
  Serial.println("// https://github.com/Bodmer/JPEGDecoder");
  Serial.println("");
  Serial.println("#if defined(__AVR__)");
  Serial.println("  #include <avr/pgmspace.h>");
  Serial.println("#endif");
  Serial.println("");
  

  
  Serial.print  ("const uint8_t ");
  while (*filename != '.') {inte = inte +(*filename); Serial.print(*filename++);}
  // Serial.println("[] PROGMEM = {"); // PROGMEM added for AVR processors, it is ignored by Due

                              
                                
                                 String intestazione = "const uint8_t ";
                                 intestazione = intestazione + inte + "[] PROGMEM = { ";
                                 Serial.println(intestazione);
                                    File dataFile = SD.open("/"+inte+".h", FILE_WRITE);
                                     dataFile.print(intestazione);
                                      dataFile.println();
                                      
                                 
  while ( jpgFile.available()) {

    data = jpgFile.read();
     Serial.print("0x"); if (abs(data) < 16)  Serial.print("0"); 
      dataFile.print("0x"); if (abs(data) < 16)  dataFile.print("0");
      Serial.print(data, HEX); Serial.print(", ");// Add value and comma
        dataFile.print(data, HEX); dataFile.print(", ");
        ContaBite = ContaBite +1;
      
       
                                      
    line_len++;
      if ( line_len >= 32) {            
       line_len = 0;      
       Serial.println();
          dataFile.println(); 
      
   }
  
  }

//  Serial.println("};\r\n");
   dataFile.println("};\r\n");
    jpgFile.close();
     dataFile.close(); 

Serial.print ( " Dimensione File = " ) ; Serial.println( ContaBite);
     
}

//====================================================================================
